## sdkconfig.defaults
```kconfig
CONFIG_COMPILER_CXX_EXCEPTIONS=y
CONFIG_COMPILER_CXX_RTTI=y
CONFIG_MBEDTLS_HARDWARE_RSA_DS_PERIPHERAL=y

# Network latency optimisations
CONFIG_LWIP_TCP_TMR_INTERVAL=100
CONFIG_LWIP_TCP_RTO_TIME=500
CONFIG_ESP_WIFI_STA_DISCONNECTED_PM_ENABLE=n
```
